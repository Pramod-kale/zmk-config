#include "asteroid.dtsi"

&kscan0 {
    row-gpios
        = <&pro_micro 0 6 (GPIO_ACTIVE_HIGH | GPIO_PULL_DOWN)>  // P0.06 (row1)
        , <&pro_micro 0 8 (GPIO_ACTIVE_HIGH | GPIO_PULL_DOWN)>  // P0.08 (row2)
        , <&pro_micro 0 17 (GPIO_ACTIVE_HIGH | GPIO_PULL_DOWN)> // P0.17 (row3)
        , <&pro_micro 0 20 (GPIO_ACTIVE_HIGH | GPIO_PULL_DOWN)> // P0.20 (row4)
        , <&pro_micro 0 22 (GPIO_ACTIVE_HIGH | GPIO_PULL_DOWN)> // P0.22 (row5)
        , <&pro_micro 0 11 (GPIO_ACTIVE_HIGH | GPIO_PULL_DOWN)> // P0.11 (row6)
        ;
    col-gpios
        = <&pro_micro 1 15 GPIO_ACTIVE_HIGH> // P1.15 (col1)
        , <&pro_micro 1 0 GPIO_ACTIVE_HIGH>  // P1.00 (col2)
        , <&pro_micro 1 4 GPIO_ACTIVE_HIGH>  // P1.04 (col3)
        , <&pro_micro 1 6 GPIO_ACTIVE_HIGH>  // P1.06 (col4)
        , <&pro_micro 1 13 GPIO_ACTIVE_HIGH> // P1.13 (col5)
        , <&pro_micro 1 11 GPIO_ACTIVE_HIGH> // P1.11 (col6)
        ;
};