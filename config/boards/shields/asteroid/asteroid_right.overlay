#include "asteroid.dtsi"

&default_transform {
    col-offset = <6>;
};

&kscan0 {
    row-gpios
        = <&pro_micro 0 31 (GPIO_ACTIVE_HIGH | GPIO_PULL_DOWN)> // P0.31 (row1)
        , <&pro_micro 0 29 (GPIO_ACTIVE_HIGH | GPIO_PULL_DOWN)> // P0.29 (row2)
        , <&pro_micro 0 2 (GPIO_ACTIVE_HIGH | GPIO_PULL_DOWN)>  // P0.02 (row3)
        , <&pro_micro 0 10 (GPIO_ACTIVE_HIGH | GPIO_PULL_DOWN)> // P0.10 (row4)
        , <&pro_micro 0 9 (GPIO_ACTIVE_HIGH | GPIO_PULL_DOWN)>  // P0.09 (row5)
        , <&pro_micro 0 24 (GPIO_ACTIVE_HIGH | GPIO_PULL_DOWN)>  // P0.24 (row6)
        ;
    col-gpios
        = <&pro_micro 1 15 GPIO_ACTIVE_HIGH> // P1.15 (col1)
        , <&pro_micro 1 13 GPIO_ACTIVE_HIGH> // P1.13 (col2)
        , <&pro_micro 1 11 GPIO_ACTIVE_HIGH> // P1.11 (col3)
        , <&pro_micro 1 0 GPIO_ACTIVE_HIGH>  // P1.00 (col4)
        , <&pro_micro 1 4 GPIO_ACTIVE_HIGH>  // P1.04 (col5)
        , <&pro_micro 1 6 GPIO_ACTIVE_HIGH>  // P1.06 (col6)
        ;
};